## Kernel/drivers/backports/Kconfig.package.hacks
```kconfig
# some hacks for when we use backports to generate a package
# to build modules out of tree.
config WIRELESS
	def_bool y
config NET_CORE
	def_bool y
config EXPERT
	def_bool y
config MAC80211
	def_tristate m
config WLCORE_SDIO
	def_tristate m
```

## Kernel/fs/ext4/Kconfig.rej
```kconfig
--- fs/ext4/Kconfig
+++ fs/ext4/Kconfig
@@ -82,7 +82,8 @@
 	  Enables run-time debugging support for the ext4 filesystem.
 
 	  If you select Y here, then you will be able to turn on debugging
-	  with a command such as "echo 1 > /sys/kernel/debug/ext4/mballoc-debug"
+	  with a command such as:
+		echo 1 > /sys/module/ext4/parameters/mballoc_debug
 
 config FEATURE_HUAWEI_EMERGENCY_DATA
     bool "EXT4 huawei emergency data function support"
```
